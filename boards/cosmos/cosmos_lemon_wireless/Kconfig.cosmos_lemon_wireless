## boards/cosmos/cosmos_lemon_wireless/board.yml
```yaml
board:
  name: cosmos_lemon_wireless
  full_name: Cosmos Lemon Wireless
  vendor: cosmos
  socs:
    - name: nrf52840
```

## boards/shields/pedanticv4/Kconfig.defconfig
```kconfig
if SHIELD_pedanticv4_DONGLE

config ZMK_KEYBOARD_NAME
    default "Pedantic-v4"

config ZMK_SPLIT_ROLE_CENTRAL
    default y

endif # SHIELD_pedanticv4_DONGLE

if SHIELD_pedanticv4_LEFT || SHIELD_pedanticv4_RIGHT || SHIELD_pedanticv4_DONGLE

config ZMK_SPLIT
    default y

endif # SHIELD_pedanticv4_LEFT || SHIELD_pedanticv4_RIGHT || SHIELD_pedanticv4_DONGLE
```

## boards/shields/pedanticv4/Kconfig.shield
```kconfig
config SHIELD_pedanticv4_LEFT
    def_bool $(shields_list_contains,pedanticv4_left)

config SHIELD_pedanticv4_RIGHT
    def_bool $(shields_list_contains,pedanticv4_right)

config SHIELD_pedanticv4_DONGLE
    def_bool $(shields_list_contains,pedanticv4_dongle)
```

## config/west.yml
```yaml
manifest:
  remotes:
    - name: zmkfirmware
      url-base: https://github.com/zmkfirmware
    - name: carrefinho
      url-base: https://github.com/carrefinho
    - name: rianadon
      url-base: https://github.com/rianadon
  projects:
    - name: zmk
      remote: zmkfirmware
      revision: main
      import: app/west.yml
    - name: prospector-zmk-module 
      remote: carrefinho
      revision: feat/new-status-screens
  self:
    path: config
    import: deps.yml
```
